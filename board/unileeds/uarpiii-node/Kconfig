## board/unileeds/uarpiii-node/Kconfig
```kconfig
if TARGET_SOCFPGA_UARPIII

config SYS_CPU
	default "armv7"

config SYS_BOARD
	default "uarpiii-node"

config SYS_VENDOR
	default "unileeds"

config SYS_SOC
	default "socfpga_uarpiii"

config SYS_CONFIG_NAME
	default "socfpga_uarpiii"

endif
```

## configs/uarpiii_defconfig
```kconfig
# Board Type
CONFIG_DEFAULT_DEVICE_TREE="uarpiii_recovery"
CONFIG_DEFAULT_FDT_FILE="uarpiii_recovery.dtb"
CONFIG_IDENT_STRING="UARPIII Node"

# Hardware Type
CONFIG_ARM=y
CONFIG_SYS_L2_PL310=y
CONFIG_ARCH_SOCFPGA=y
CONFIG_SPL_FPGA=y
CONFIG_TARGET_SOCFPGA_UARPIII=y
CONFIG_SYS_NS16550_MEM32=y
CONFIG_DESIGNWARE_APB_TIMER=y

# Sizes
# SPL is located at the bottom of the on-chip RAM (192kB available to SPL)
CONFIG_SPL_TEXT_BASE=0xFFE00000
CONFIG_SPL_PAD_TO=0x30000
CONFIG_SPL_STACK=0xffe28000
CONFIG_HAS_CUSTOM_SYS_INIT_SP_ADDR=y
CONFIG_CUSTOM_SYS_INIT_SP_ADDR=0xffe2b000
CONFIG_HAS_CUSTOM_SPL_MALLOC_START=y
CONFIG_CUSTOM_SYS_SPL_MALLOC_ADDR=0xffe2b000
CONFIG_SYS_SPL_MALLOC=y
CONFIG_SYS_SPL_MALLOC_SIZE=0x5000
# We then load our custom bootloader to start 192kB into the on-chip RAM as we have no DDR.
# The custom bootloader (run after SPL) will then load our actual program image to the bottom
# of the RAM (the space used by the SPL freed up by that point).
CONFIG_TEXT_BASE=0xFFE30000
CONFIG_SYS_MONITOR_LEN=65536
# Env paramters for SD card for U-Boot proper
CONFIG_ENV_SIZE=0x2000
CONFIG_ENV_OFFSET=0x4400

# MMC
CONFIG_SYS_MMC_MAX_BLK_COUNT=256
CONFIG_MMC_DW=y
CONFIG_ENV_IS_IN_MMC=y
CONFIG_CMD_MMC=y

# Others
CONFIG_DM_GPIO=y
CONFIG_DWAPB_GPIO=y
CONFIG_OF_SPL_REMOVE_PROPS="interrupts interrupt-parent dmas dma-names clocks"
CONFIG_SPL_DM_SEQ_ALIAS=y
CONFIG_SPL_DRIVERS_MISC=y
CONFIG_SPL_ENV_SUPPORT=y
CONFIG_SPL_FS_LOADER=y
CONFIG_SPL_NO_BSS_LIMIT=y
CONFIG_CMD_FPGA_LOADMK=y
CONFIG_CMD_GPIO=y
CONFIG_CMD_CACHE=y
CONFIG_CLOCKS=y
CONFIG_TIMESTAMP=y
CONFIG_DISPLAY_BOARDINFO_LATE=y
CONFIG_FIT=y
CONFIG_SPL_FIT=y
CONFIG_FS_LOADER=y
CONFIG_SPL_RAW_IMAGE_SUPPORT=y

# Peripherals
CONFIG_TIMER=y
CONFIG_SPL_TIMER=y
CONFIG_ETH_DESIGNWARE=y
```

## configs/unileeds_lsc_defconfig
```kconfig
# Board Type
CONFIG_DEFAULT_DEVICE_TREE="socfpga_cyclone5_de1_soc"
CONFIG_DEFAULT_FDT_FILE="socfpga_cyclone5_de1_soc.dtb"
CONFIG_IDENT_STRING="Leeds SoC Computer"

# Hardware Type
CONFIG_ARM=y
CONFIG_SYS_L2_PL310=y
CONFIG_ARCH_SOCFPGA=y
CONFIG_SPL_FPGA=y
CONFIG_TARGET_SOCFPGA_UNILEEDS_LSC=y

# Enable HPS bridge before loading image
CONFIG_SPL_SOCFPGA_ENABLE_BRIDGE=y

# Sizes
CONFIG_SPL_TEXT_BASE=0xFFFF0000
CONFIG_SPL_PAD_TO=0x10000
CONFIG_SPL_STACK=0x0
CONFIG_HAS_CUSTOM_SYS_INIT_SP_ADDR=y
CONFIG_CUSTOM_SYS_INIT_SP_ADDR=0x800000
CONFIG_SYS_MALLOC_LEN=0x4000000
CONFIG_ENV_SIZE=0x2000
CONFIG_ENV_OFFSET=0x4400

# MMC
CONFIG_MMC_DW=y
CONFIG_DOS_PARTITION=y
CONFIG_SPL_FS_FAT=y
CONFIG_SPL_FS_LOAD_PAYLOAD_NAME="bootloader-mkpimage.bin"

# Others
CONFIG_DM_GPIO=y
CONFIG_DM_RESET=y
CONFIG_FIT=y
CONFIG_TIMESTAMP=y
CONFIG_DISTRO_DEFAULTS=y
# CONFIG_USE_BOOTCOMMAND is not set
CONFIG_SYS_CONSOLE_IS_IN_ENV=y
CONFIG_SYS_CONSOLE_OVERWRITE_ROUTINE=y
CONFIG_SYS_CONSOLE_ENV_OVERWRITE=y
# CONFIG_DISPLAY_BOARDINFO is not set
CONFIG_DISPLAY_BOARDINFO_LATE=y
CONFIG_CLOCKS=y
CONFIG_SPL_NO_BSS_LIMIT=y
# CONFIG_SPL_RAW_IMAGE_SUPPORT is not set
# CONFIG_SPL_SHARES_INIT_SP_ADDR is not set
CONFIG_SPL_YMODEM_SUPPORT=y
CONFIG_SYS_MAXARGS=32
CONFIG_CMD_ASKENV=y
CONFIG_CMD_GREPENV=y
# CONFIG_CMD_FLASH is not set
CONFIG_CMD_GPIO=y
CONFIG_CMD_I2C=y
CONFIG_CMD_MMC=y
CONFIG_CMD_SPI=y
CONFIG_CMD_USB=y
CONFIG_CMD_CACHE=y
CONFIG_CMD_TIME=y
CONFIG_CMD_EXT4_WRITE=y
CONFIG_MTDIDS_DEFAULT="nor0=ff705000.spi.0"
# CONFIG_ISO_PARTITION is not set
# CONFIG_EFI_PARTITION is not set
CONFIG_ENV_IS_IN_MMC=y
CONFIG_SYS_RELOC_GD_ENV_ADDR=y
CONFIG_VERSION_VARIABLE=y
CONFIG_DWAPB_GPIO=y
CONFIG_DM_I2C=y
CONFIG_SYS_I2C_DW=y
CONFIG_SYS_MMC_MAX_BLK_COUNT=256
CONFIG_MTD=y
CONFIG_PHY_MICREL=y
CONFIG_PHY_MICREL_KSZ90X1=y
CONFIG_ETH_DESIGNWARE=y
CONFIG_MII=y
CONFIG_SPI=y
CONFIG_USB=y
CONFIG_USB_DWC2=y
CONFIG_SPL_WDT=y
CONFIG_WDT=y
CONFIG_SYS_TIMER_COUNTS_DOWN=y
# CONFIG_EFI_LOADER is not set
CONFIG_SPL_RESET_SOCFPGA_KEEP_ENABLED=y
```

## configs/unileeds_uarpiii_defconfig
```kconfig
# Board Type
CONFIG_DEFAULT_DEVICE_TREE="uarpiii_recovery"
CONFIG_DEFAULT_FDT_FILE="uarpiii_recovery.dtb"
CONFIG_IDENT_STRING="UARPIII Node"
CONFIG_SPL_DISPLAY_PRINT=y

# Hardware Type
CONFIG_ARM=y
CONFIG_SYS_L2_PL310=y
CONFIG_ARCH_SOCFPGA=y
CONFIG_SPL_FPGA=y
CONFIG_TARGET_SOCFPGA_UARPIII=y
CONFIG_SYS_NS16550_MEM32=y
CONFIG_DESIGNWARE_APB_TIMER=y

# No RAM
CONFIG_SPL_ALTERA_SDRAM=n

# Enable HPS bridge before loading image
CONFIG_SPL_SOCFPGA_ENABLE_BRIDGE=y

# Sizes
# SPL is located at the bottom of the on-chip RAM (up to 192kB available to SPL)
# We pad to 256kB as required by Arria 10 Boot ROM. Max boot memory length is 64kB
# as we start the recovery image at 0xFFE30000.
CONFIG_SPL_TEXT_BASE=0xFFE00000
CONFIG_SPL_PAD_TO=0x40000
CONFIG_SPL_STACK=0xffe28000
CONFIG_HAS_CUSTOM_SYS_INIT_SP_ADDR=y
CONFIG_CUSTOM_SYS_INIT_SP_ADDR=0xffe20000
CONFIG_HAS_CUSTOM_SPL_MALLOC_START=y
CONFIG_CUSTOM_SYS_SPL_MALLOC_ADDR=0xffe20000
CONFIG_SYS_SPL_MALLOC=y
CONFIG_SYS_SPL_MALLOC_SIZE=0x10000
CONFIG_SYS_BOOTM_LEN=0x10000
CONFIG_SYS_ICACHE_OFF=y
CONFIG_SYS_DCACHE_OFF=y

# We then load our custom bootloader to start 192kB into the on-chip RAM as we have no DDR.
# The custom bootloader (run after SPL) will then load our actual program image to the bottom
# of the RAM (the space used by the SPL freed up by that point).
CONFIG_TEXT_BASE=0xFFE30000
CONFIG_SYS_MONITOR_LEN=65536
# Env paramters for SD card for U-Boot proper. This isn't used, but needed to prevent compile issues
CONFIG_ENV_SIZE=0x2000
CONFIG_ENV_OFFSET=0x4400

# MMC
CONFIG_SYS_MMC_MAX_BLK_COUNT=256
CONFIG_MMC_DW=y
CONFIG_ENV_IS_IN_MMC=y
CONFIG_CMD_MMC=y
CONFIG_SPL_LEGACY_IMAGE_CRC_CHECK=y
CONFIG_DOS_PARTITION=y
CONFIG_SYS_MMCSD_RAW_MODE_U_BOOT_PARTITION_TYPE=0xDA

# Others
CONFIG_DM_GPIO=y
CONFIG_DWAPB_GPIO=y
CONFIG_OF_SPL_REMOVE_PROPS="interrupts interrupt-parent dmas dma-names clock-names"
CONFIG_SPL_DM_SEQ_ALIAS=y
CONFIG_SPL_DRIVERS_MISC=y
CONFIG_SPL_ENV_SUPPORT=y
CONFIG_SPL_FS_LOADER=y
CONFIG_SPL_NO_BSS_LIMIT=y
CONFIG_CMD_FPGA_LOADMK=y
CONFIG_CMD_GPIO=y
CONFIG_CMD_CACHE=y
CONFIG_CLOCKS=y
CONFIG_TIMESTAMP=y
CONFIG_DISPLAY_BOARDINFO_LATE=y
CONFIG_FIT=y
CONFIG_SPL_FIT=y
CONFIG_FS_LOADER=y
CONFIG_SPL_RAW_IMAGE_SUPPORT=y

# Peripherals
CONFIG_TIMER=y
CONFIG_SPL_TIMER=y
CONFIG_ETH_DESIGNWARE=y
CONFIG_SPL_RESET_SOCFPGA_KEEP_ENABLED=y
```
